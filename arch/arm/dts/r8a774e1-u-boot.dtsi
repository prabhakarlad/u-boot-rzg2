// SPDX-License-Identifier: GPL-2.0
/*
 * Device Tree Source extras for U-Boot on RZ/G2 R8A774E1 SoC
 *
 * Copyright (C) 2020 Renesas Electronics Corp.
 */

#include "r8a779x-u-boot.dtsi"

&extalr_clk {
	u-boot,dm-pre-reloc;
};

/delete-node/ &can0;
/delete-node/ &can1;
/delete-node/ &canfd;
/delete-node/ &du;
/delete-node/ &hdmi0;
/delete-node/ &rcar_sound;
/delete-node/ &sdhi2;
/delete-node/ &sound_card;

/ {
	/delete-node/ hdmi0-out;
};
